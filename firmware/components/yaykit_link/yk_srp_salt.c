#include "yk_srp_salt.h"

#include <stdlib.h>
#include <string.h>

#include "esp_random.h"
#include "mbedtls/bignum.h"
#include "mbedtls/sha512.h"

// RFC 5054's 3072-bit group, g = 5: the one esp_srp and protocomm security 2 use (ESP_NG_3072).
static const uint8_t N_3072[384] = {
    0xFF, 0xFF, 0xFF, 0xFF, 0xFF, 0xFF, 0xFF, 0xFF, 0xC9, 0x0F, 0xDA, 0xA2, 0x21, 0x68, 0xC2, 0x34,
    0xC4, 0xC6, 0x62, 0x8B, 0x80, 0xDC, 0x1C, 0xD1, 0x29, 0x02, 0x4E, 0x08, 0x8A, 0x67, 0xCC, 0x74,
    0x02, 0x0B, 0xBE, 0xA6, 0x3B, 0x13, 0x9B, 0x22, 0x51, 0x4A, 0x08, 0x79, 0x8E, 0x34, 0x04, 0xDD,
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    0x4B, 0x82, 0xD1, 0x20, 0xA9, 0x3A, 0xD2, 0xCA, 0xFF, 0xFF, 0xFF, 0xFF, 0xFF, 0xFF, 0xFF, 0xFF
};

esp_err_t yk_srp_verifier(const char *user, const char *pass, const uint8_t salt[YK_SRP_SALT_LEN], char **verifier,
                          int *verifier_len) {
    // x = H(s | H(I ":" P)), v = g^x mod N, as esp_srp computes them (calculate_x, _esp_srp_gen_salt_verifier).
    uint8_t inner[64], x_bytes[64];
    mbedtls_sha512_context h;
    mbedtls_sha512_init(&h);
    mbedtls_sha512_starts(&h, 0);
    mbedtls_sha512_update(&h, (const unsigned char *)user, strlen(user));
    mbedtls_sha512_update(&h, (const unsigned char *)":", 1);
    mbedtls_sha512_update(&h, (const unsigned char *)pass, strlen(pass));
    mbedtls_sha512_finish(&h, inner);
    mbedtls_sha512_starts(&h, 0);
    mbedtls_sha512_update(&h, salt, YK_SRP_SALT_LEN);
    mbedtls_sha512_update(&h, inner, sizeof(inner));
    mbedtls_sha512_finish(&h, x_bytes);
    mbedtls_sha512_free(&h);
    mbedtls_mpi n, g, x, v;
    mbedtls_mpi_init(&n), mbedtls_mpi_init(&g), mbedtls_mpi_init(&x), mbedtls_mpi_init(&v);
    int ret = mbedtls_mpi_read_binary(&n, N_3072, sizeof(N_3072));
    if (!ret) ret = mbedtls_mpi_lset(&g, 5);
    if (!ret) ret = mbedtls_mpi_read_binary(&x, x_bytes, sizeof(x_bytes));
    if (!ret) ret = mbedtls_mpi_exp_mod(&v, &g, &x, &n, NULL);
    esp_err_t err = ret ? ESP_FAIL : ESP_OK;
    if (err == ESP_OK) {
        *verifier_len = (int)mbedtls_mpi_size(&v);
        *verifier = malloc((size_t)*verifier_len);
        if (!*verifier || mbedtls_mpi_write_binary(&v, (unsigned char *)*verifier, (size_t)*verifier_len)) {
            free(*verifier);
            *verifier = NULL;
            err = ESP_ERR_NO_MEM;
        }
    }
    mbedtls_mpi_free(&n), mbedtls_mpi_free(&g), mbedtls_mpi_free(&x), mbedtls_mpi_free(&v);
    memset(inner, 0, sizeof(inner));
    memset(x_bytes, 0, sizeof(x_bytes));
    return err;
}

esp_err_t yk_srp_salt_verifier(const char *user, const char *pass, uint8_t salt[YK_SRP_SALT_LEN], char **verifier,
                               int *verifier_len) {
    // Never a 0 first byte. esp_srp_gen_salt_verifier() writes its random salt at its own length, so such a salt comes
    // out a byte short while its caller and the phone take 16 (and the phone's library drops leading zeros too): no
    // phone could pair in that session, 1 time in 256 (found 2026-10-19 with the Android app).
    do esp_fill_random(salt, YK_SRP_SALT_LEN);
    while (salt[0] == 0);
    return yk_srp_verifier(user, pass, salt, verifier, verifier_len);
}
